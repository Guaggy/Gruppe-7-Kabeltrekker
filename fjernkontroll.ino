#include <SPI.h>
#include <nRF24L01.h>
#include <RF24.h>
#include <Wire.h>
#include <Adafruit_GFX.h>
#include <Adafruit_SSD1306.h>

//modus
int driveMode = 1; //0 = admin, 1 = auto
int autoGoMode = 0; //0 = kjører ikke, 1 = frem-tilbake , 2 = frem-tilbake-frem

//skjærm
#define SCREEN_WIDTH 128
#define SCREEN_HEIGHT 64
#define OLED_RESET     -1
#define SCREEN_ADDRESS 0x3C 
Adafruit_SSD1306 display(SCREEN_WIDTH, SCREEN_HEIGHT, &Wire, OLED_RESET);

//Joystick
#define joystickXpin A0
#define joystickYpin A1
int joystickXval = 0;
int joystickYval = 0;

//knapper
int button0pin = 5;
int button1pin = 6;
int button2pin = 7;
int lastButton0val = 1;
int lastButton1val = 1;
int lastButton2val = 1;
int button0press = 0;
int button1press = 0;
int button2press = 0;

//lys
int led0pin = 8;
int led1pin = 9;
int led2pin = 10;

//annet
bool failure = false;
int selectedTrack = 1;
int numOfTrack = 10;
int altJoystickXval = 0;
int lastAltJoystickXval = 0;
int numStepsToDrive = 0;
int maxNumStepsToDrive = 10; //begrenser hvor mange trinn den kan kjøre
int altJoystickYval = 0;
int lastAltJoystickYval = 0;
int joystickPushval = 0;
int lastJoystickPushval = 0;
int batteryPercentage = 0;
int numStepsDriven = 0;
int autoRound = 0;
int autoPercentage = 0;

//radio
const byte radioAdressList[][6] = {"00001","00002"};
#define CE_pin 3
#define CSN_pin 2
RF24 radio(CE_pin, CSN_pin);
int radioSendDelay = 0;
long radioLastSendTime = 0;
int screenUpdateDelay = 100;
long lastScreenUpdateTime = 0;
int radioRecieveTimeLimit = 300; //fiks
long radioLastRecieveTime = 0; //fiks

struct payloadsend {
  byte ch1; //selectedTrack
  byte ch2; //motot fremgang
  byte ch3; //joystick push
  byte ch4; //b0
  byte ch5; //b1
  byte ch6; //b2
  byte ch7; //modus
  byte ch8; //antall planlagte trinn
};
payloadsend payloadsend;

struct payloadrec {
  byte ch1; //battery %
  byte ch2; //antall trinn kjørt
  byte ch3; //kjører 1/0
  byte ch4; //autoRound som kjøres
};
payloadrec payloadrec;

//logo
const unsigned char Logobitmap [] PROGMEM = {
	0x00, 0x00, 0x00, 0x00, 0x00, 0x00, 0x00, 0x1f, 0xfe, 0x00, 0x00, 0x00, 0x00, 0x00, 0x00, 0x00, 
	0x00, 0x00, 0x00, 0x00, 0x00, 0x00, 0x01, 0xf0, 0x07, 0xe0, 0x00, 0x00, 0x00, 0x00, 0x00, 0x00, 
	0x00, 0x00, 0x00, 0x00, 0x00, 0x00, 0x07, 0x00, 0x00, 0x38, 0x00, 0x00, 0x00, 0x00, 0x00, 0x00, 
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	0x00, 0x00, 0x00, 0x00, 0x00, 0x00, 0x00, 0x00, 0x00, 0x00, 0x00, 0x00, 0x00, 0x00, 0x00, 0x00
};

void setup() {
  //generell oppstart
  Serial.begin(9600);
  pinMode(joystickYpin, INPUT);
  pinMode(joystickXpin, INPUT);
  pinMode(button0pin, INPUT_PULLUP);
  pinMode(button1pin, INPUT_PULLUP);
  pinMode(button2pin, INPUT_PULLUP);
  pinMode(led0pin, OUTPUT);
  pinMode(led1pin, OUTPUT);
  pinMode(led2pin, OUTPUT);
  digitalWrite(led0pin, 0);
  digitalWrite(led1pin, 0);
  digitalWrite(led2pin, 0);
  lastButton0val = digitalRead(button0pin);
  lastButton1val = digitalRead(button1pin);
  lastButton2val = digitalRead(button2pin);

  //kjøremodus valg
  if (digitalRead(button2pin) == 0) { //admin
    driveMode = 1;
  } 
  payloadsend.ch7 = driveMode;

  //skjærm oppstart
  if(display.begin(SSD1306_SWITCHCAPVCC, SCREEN_ADDRESS)) {
    Serial.println("Screen boot ok");
  }
  else {
    Serial.println("No connection with Oled screen");
    failure = true;
  }
  display.display();
  display.clearDisplay();
  //logo og boot animasjon
  display.drawBitmap(0, 0, Logobitmap, 128, 64, WHITE);
  display.display();
  delay(3000);
  display.clearDisplay();
  display.setTextSize(2);
  display.setTextColor(SSD1306_WHITE);
  display.setCursor(0,0);
  display.println(F("BOOTING..."));
  display.drawRect(10,20,108,20, SSD1306_WHITE);
  display.display();
  display.fillRect(10,20,27,20, SSD1306_WHITE);
  display.display();
  delay(300);
  display.fillRect(10,20,27*2,20, SSD1306_WHITE);
  display.display();
  delay(300);
  display.fillRect(10,20,27*3,20, SSD1306_WHITE);
  display.display();
  delay(300);
  display.fillRect(10,20,27*4,20, SSD1306_WHITE);
  display.display();
  delay(300);
  display.setTextSize(2);
  display.setCursor(0,30);
  //starte radio og vis status på skjerm
  if (radio.begin()) {
    Serial.println("Radio boot OK");
    display.println();
    display.println(F("OK"));
    display.display();
  }
  else {
    Serial.println("No connection with NRF24");
    failure = true;
    display.println();
    display.println(F("FAILED"));
    display.display();
  }
  delay(1000);
  radio.setAutoAck(false);
  radio.setDataRate(RF24_250KBPS);
  radio.setPALevel(RF24_PA_MAX);
  radio.openWritingPipe(radioAdressList[0]);
  radio.openReadingPipe(0, radioAdressList[1]);
}

void loop() {
  //joystick
  joystickXval = map(analogRead(joystickXpin), 240, 785, 0, 255); 
  joystickYval = map(analogRead(joystickYpin), 240, 785, 255, 0);
  payloadsend.ch2 = joystickYval;

  //joystick press
  joystickPushval = 0;
  payloadsend.ch3 = 0;
  if (analogRead(joystickYpin) >= 900) {
    joystickPushval = 1;
  }
  if (joystickPushval != lastJoystickPushval && joystickPushval == 1) {
    payloadsend.ch3 = 1;
    numStepsToDrive++;
  }
  lastJoystickPushval = joystickPushval;

  //verdier til auto fremgang
  if (driveMode == 1) {
    altJoystickYval = 0;
    if (joystickYval >= 240) {
      altJoystickYval = 1;
    }
    if (joystickYval <= 15) {
      altJoystickYval = -1;
    }
    if (altJoystickYval != lastAltJoystickYval && altJoystickYval == 1) {
      numStepsToDrive++;
    }
    if (altJoystickYval != lastAltJoystickYval && altJoystickYval == -1) {
      numStepsToDrive--;
    }
    lastAltJoystickYval = altJoystickYval;
    if(numStepsToDrive > maxNumStepsToDrive) {
      numStepsToDrive = maxNumStepsToDrive;
    }
    if(numStepsToDrive < 0) {
      numStepsToDrive = 0;
    }
    payloadsend.ch8 = numStepsToDrive;
  }

  //verdier til bom
  altJoystickXval = 0;
  if (joystickXval >= 240) {
    altJoystickXval = 1;
  }
  if (joystickXval <= 15) {
    altJoystickXval = -1;
  }
  if (altJoystickXval != lastAltJoystickXval && altJoystickXval == 1) {
    selectedTrack++;
  }
  if (altJoystickXval != lastAltJoystickXval && altJoystickXval == -1) {
    selectedTrack--;
  }
  lastAltJoystickXval = altJoystickXval;
  if(selectedTrack > numOfTrack) {
    selectedTrack = numOfTrack;
  }
  if(selectedTrack < 1) {
    selectedTrack = 1;
  }
  payloadsend.ch1 = selectedTrack;

  //knapper
  button0press = 0;
  button1press = 0;
  button2press = 0;
  if ((digitalRead(button0pin) == 0) && (lastButton0val == 1)) {
    button0press = 1;
  }
  if ((digitalRead(button1pin) == 0) && (lastButton1val == 1)) {
    button1press = 1;
  }
  if ((digitalRead(button2pin) == 0) && (lastButton2val == 1)) {
    button2press = 1;
  }
  lastButton0val = digitalRead(button0pin);
  lastButton1val = digitalRead(button1pin);
  lastButton2val = digitalRead(button2pin);
  payloadsend.ch4 = button0press;
  payloadsend.ch5 = button1press;
  payloadsend.ch6 = button2press;

  //send data
  radio.stopListening();
  radio.setPayloadSize(sizeof(payloadsend));
  //delay(5);
  if (millis() >= radioLastSendTime + radioSendDelay) {
    sendRadio();
  }
  //motta data
  radio.startListening();
  radio.setPayloadSize(sizeof(payloadrec));
  //delay(5);
  if (radio.available()) {
    readRadio();
  }
  //oppdatere skjærm
  if (millis() >= lastScreenUpdateTime + screenUpdateDelay) {
    updateDisplay();
  }
  //led-lys
  if((millis() >= radioLastRecieveTime + radioRecieveTimeLimit) || failure) {
    digitalWrite(led2pin, 1);
  }
  else {
    digitalWrite(led2pin, 0);
  }
  if (driveMode == 1) {
    digitalWrite(led1pin, 1);
  }
  else {
    digitalWrite(led1pin, 0);
  }
  if (autoGoMode == 2) {
    digitalWrite(led0pin, 1);
  }
  else {
    digitalWrite(led0pin, 0);
  }
}

void sendRadio() {
  radio.write(&payloadsend, sizeof(payloadsend));
  Serial.print(payloadsend.ch1);
  Serial.print("   ");
  Serial.print(payloadsend.ch2);
  Serial.print("   ");
  Serial.print(payloadsend.ch3);
  Serial.print("   ");
  Serial.print(payloadsend.ch4);
  Serial.print("   ");
  Serial.print(payloadsend.ch5);
  Serial.print("   ");
  Serial.print(payloadsend.ch6);
  Serial.print("   ");
  Serial.print(payloadsend.ch7);
  Serial.print("   ");
  Serial.println(payloadsend.ch8);
}

void readRadio() {
  radio.read(&payloadrec, sizeof(payloadrec));
  batteryPercentage = payloadrec.ch1;
  numStepsDriven = payloadrec.ch2;
  autoGoMode = payloadrec.ch3;
  autoRound = payloadrec.ch4;
  Serial.print(batteryPercentage);
  Serial.print("   ");
  Serial.print(numStepsDriven);
  Serial.print("   ");
  Serial.print(autoGoMode);
  Serial.print("   ");
  Serial.println(autoRound);
  Serial.println();
}

void updateDisplay() {
  display.clearDisplay();
  display.setCursor(0,3);
  display.setTextSize(2);
  if(driveMode == 1) {
    display.print(F("AUTO"));
  }
  else {
    display.print(F("ADMIN"));
  }
  if(autoGoMode == 0) {
    display.fillRect(60,2,15,15, SSD1306_WHITE);
  }
  else {
    display.fillTriangle(60, 2, 60, 22 , 75, 12, SSD1306_WHITE);
  }
  display.drawRect(80,2,40,20, SSD1306_WHITE);
  display.fillRect(80,2,((40./100.)*batteryPercentage)/1,20, SSD1306_WHITE);
  display.fillRect(120,10,3,4, SSD1306_WHITE);
  display.drawLine(0,25,128,25, SSD1306_WHITE);
  display.setCursor(0,30);
  display.print(F("Track: "));
  display.println(selectedTrack);
  if (driveMode == 1) {
    if (autoGoMode == 0) {
      display.print(F("Dist: "));
      display.println(numStepsToDrive*0.25);
      numStepsDriven = 0;
    }
    else {
      autoPercentage = map(autoRound*numStepsToDrive+numStepsDriven,0,numStepsToDrive*(autoGoMode+1),0,120);
      display.drawRect(4,52,120,12, SSD1306_WHITE);
      display.fillRect(4,52,autoPercentage,12, SSD1306_WHITE);
    }
  }
  else {
    display.print(F("Dist: "));
    display.println(numStepsDriven*0.25);
  }
  display.display();
}
