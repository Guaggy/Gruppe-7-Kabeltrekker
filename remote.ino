//kode for fjernkontroll
#include <SPI.h>
#include <nRF24L01.h>
#include <RF24.h>
#include <Wire.h>
#include <Adafruit_GFX.h>
#include <Adafruit_SSD1306.h>

//modus
int autonom = 2; //2 = autonom, 1 = admin
int go = 1;

//skjærm
#define SCREEN_WIDTH 128
#define SCREEN_HEIGHT 64
#define OLED_RESET     -1
#define SCREEN_ADDRESS 0x3C 
Adafruit_SSD1306 display(SCREEN_WIDTH, SCREEN_HEIGHT, &Wire, OLED_RESET);

//Joystick
#define joyX A0
#define joyY A1
int xval = 0, yval = 0;

//knapper
int bpin0 = 5, bpin1 = 6, bpin2 = 7;
int lbpin0 = 1, lbpin1 = 1, lbpin2 = 1;
int push0 = 0, push1 = 0, push2 = 0;

//lys
int l0 = 8, l1 = 9, l2 = 10;

//annet
bool fail = false;
int step = 1, maxstep = 10, txval = 0, lastxval = 0;
int ptrinn = 0, maxptrinn = 10, tyval = 0, lastyval = 0;
int pval = 0, tpval = 0, lasttpval = 0;
int batper = 0;
float ktrinn = 0;

//radio
const byte address[][6] = {"00001","00002"};
#define CE_pin 3
#define CSN_pin 2
RF24 radio(CE_pin, CSN_pin);
float senddelay = 0;
float lastsend = 0;
float updatedelay = 100;
float lastupdate = 0;
bool recable = false;
float reclimit = 300, lastrec = 0;

struct payloadsend {
  byte ch1; //step
  byte ch2; //motot fremgang
  byte ch3; //joystick push
  byte ch4; //b0
  byte ch5; //b1
  byte ch6; //b2
  byte ch7; //modus
  byte ch8; //antall planlagte trinn
};
payloadsend payloadsend;

struct payloadrec {
  byte ch1; //battery %
  byte ch2; //antall trinn kjørt
  byte ch3; //kjører 1/0
};
payloadrec payloadrec;

//logo
const unsigned char Logobitmap [] PROGMEM = {
	0x00, 0x00, 0x00, 0x00, 0x00, 0x00, 0x00, 0x1f, 0xfe, 0x00, 0x00, 0x00, 0x00, 0x00, 0x00, 0x00, 
	0x00, 0x00, 0x00, 0x00, 0x00, 0x00, 0x01, 0xf0, 0x07, 0xe0, 0x00, 0x00, 0x00, 0x00, 0x00, 0x00, 
	0x00, 0x00, 0x00, 0x00, 0x00, 0x00, 0x07, 0x00, 0x00, 0x38, 0x00, 0x00, 0x00, 0x00, 0x00, 0x00, 
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	0x00, 0x00, 0x00, 0x00, 0x00, 0x00, 0x00, 0x00, 0x00, 0x00, 0x00, 0x00, 0x00, 0x00, 0x00, 0x00
};

void setup() {
  Serial.begin(9600);
  pinMode(joyY, INPUT);
  pinMode(joyX, INPUT);
  pinMode(bpin0, INPUT_PULLUP);
  pinMode(bpin1, INPUT_PULLUP);
  pinMode(bpin2, INPUT_PULLUP);

  pinMode(l0, OUTPUT);
  pinMode(l1, OUTPUT);
  pinMode(l2, OUTPUT);
  digitalWrite(l0, 0);
  digitalWrite(l1, 0);
  digitalWrite(l2, 0);

  //modus valg
  if (digitalRead(bpin2) == 0) { //admin
    autonom = 1;
  } 
  payloadsend.ch7 = autonom;

  //skjærm oppstart
  if(!display.begin(SSD1306_SWITCHCAPVCC, SCREEN_ADDRESS)) {
    Serial.println("SSD1306 allocation failed");
    fail = true;
  }
  display.display();
  display.clearDisplay();
  display.drawBitmap(0, 0, Logobitmap, 128, 64, WHITE);
  display.display();
  delay(3000);
  display.clearDisplay();
  display.setTextSize(2);
  display.setTextColor(SSD1306_WHITE);
  display.setCursor(0,0);
  display.println(F("BOOTING..."));
  display.drawRect(10,20,108,20, SSD1306_WHITE);
  display.display();
  display.fillRect(10,20,27,20, SSD1306_WHITE);
  display.display();
  delay(300);
  display.fillRect(10,20,27*2,20, SSD1306_WHITE);
  display.display();
  delay(300);
  display.fillRect(10,20,27*3,20, SSD1306_WHITE);
  display.display();
  delay(300);
  display.fillRect(10,20,27*4,20, SSD1306_WHITE);
  display.display();
  delay(300);
  display.setTextSize(2);
  display.setCursor(0,30);
  if (radio.begin()) {
    Serial.println("Boot OK");
    display.println();
    display.println(F("OK"));
    display.display();
  }
  else {
    Serial.println("No connection with NRF24");
    fail = true;
    display.println();
    display.println(F("FAILED"));
    display.display();
  }
  delay(1000);

  //radio oppstart
  radio.setAutoAck(false);
  radio.setDataRate(RF24_250KBPS);
  radio.setPALevel(RF24_PA_MAX);
  radio.openWritingPipe(address[0]);
  radio.openReadingPipe(0, address[1]);

  //knapper oppstart
  lbpin0 = digitalRead(bpin0);
  lbpin1 = digitalRead(bpin1);
  lbpin2 = digitalRead(bpin2);
}

void loop() {
  recable = false;
  //joystick
  xval = map(analogRead(joyX), 240, 785, 0, 255); 
  yval = map(analogRead(joyY), 240, 785, 255, 0);
  payloadsend.ch2 = yval;

  //joystick press
  pval = analogRead(joyY);
  tpval = 0;
  payloadsend.ch3 = 0;
  if (pval >= 900) {
    tpval = 1;
  }
  if (tpval != lasttpval && tpval == 1) {
    payloadsend.ch3 = 1;
    ptrinn++;
  }
  lasttpval = tpval;

  //verdier til auto fremgang
  if (autonom == 2) {
    tyval = 0;
    if (yval >= 240) {
      tyval = 1;
    }
    if (yval <= 15) {
      tyval = -1;
    }
    if (tyval != lastyval && tyval == 1) {
      ptrinn++;
    }
    if (tyval != lastyval && tyval == -1) {
      ptrinn--;
    }
    lastyval = tyval;
    if(ptrinn > maxptrinn) {
      ptrinn = maxptrinn;
    }
    if(ptrinn < 0) {
      ptrinn = 0;
    }
    payloadsend.ch8 = ptrinn;
  }

  //verdier til bom
  txval = 0;
  if (xval >= 240) {
    txval = 1;
  }
  if (xval <= 15) {
    txval = -1;
  }
  if (txval != lastxval && txval == 1) {
    step++;
  }
  if (txval != lastxval && txval == -1) {
    step--;
  }
  lastxval = txval;
  if(step > maxstep) {
    step = maxstep;
  }
  if(step < 1) {
    step = 1;
  }
  payloadsend.ch1 = step;

  //knapper
  push0 = 0;
  push1 = 0;
  push2 = 0;
  if ((digitalRead(bpin0) == 0) && (lbpin0 == 1)) {
    push0 = 1;
  }
  if ((digitalRead(bpin1) == 0) && (lbpin1 == 1)) {
    push1 = 1;
  }
  if ((digitalRead(bpin2) == 0) && (lbpin2 == 1)) {
    push2 = 1;
  }
  lbpin0 = digitalRead(bpin0);
  lbpin1 = digitalRead(bpin1);
  lbpin2 = digitalRead(bpin2);
  payloadsend.ch4 = push0;
  payloadsend.ch5 = push1;
  payloadsend.ch6 = push2;

  //send data
  radio.stopListening();
  radio.setPayloadSize(sizeof(payloadsend));
  delay(5);
  if (millis() >= lastsend + senddelay) {
    radio.write(&payloadsend, sizeof(payloadsend));
    Serial.print(payloadsend.ch1);
    Serial.print("   ");
    Serial.print(payloadsend.ch2);
    Serial.print("   ");
    Serial.print(payloadsend.ch3);
    Serial.print("   ");
    Serial.print(payloadsend.ch4);
    Serial.print("   ");
    Serial.print(payloadsend.ch5);
    Serial.print("   ");
    Serial.print(payloadsend.ch6);
    Serial.print("   ");
    Serial.print(payloadsend.ch7);
    Serial.print("   ");
    Serial.println(payloadsend.ch8);
    recable = true;
  }
  //motta data
  if(recable) {
    radio.startListening();
    radio.setPayloadSize(sizeof(payloadrec));
    delay(5);
    radio.read(&payloadrec, sizeof(payloadrec));
    Serial.print(payloadrec.ch1);
    Serial.print("   ");
    Serial.print(payloadrec.ch2);
    Serial.print("   ");
    Serial.println(payloadrec.ch3);
    Serial.println();
    if (payloadrec.ch1 > 1) {
      batper = payloadrec.ch1;
    }
    if (payloadrec.ch2 != 0) {
      ktrinn = payloadrec.ch2 * 0.25;
    }
    if (payloadrec.ch3 != 0) {
      go = payloadrec.ch3;
    }
  }
  //oppdatere skjærm
  if (millis() >= lastupdate + updatedelay) {
    display.setTextSize(2);
    display.clearDisplay();
    display.setCursor(0,3);
    if(autonom == 2) {
      display.print(F("AUTO"));
    }
    else {
      display.print(F("ADMIN"));
    }
    if(go == 2) {
      display.fillTriangle(60, 2, 60, 22 , 75, 12, SSD1306_WHITE);
    }
    if(go == 1) {
      display.fillRect(60,2,15,15, SSD1306_WHITE);
    }
    display.drawRect(80,2,40,20, SSD1306_WHITE);
    display.fillRect(120,10,3,4, SSD1306_WHITE);
    display.fillRect(80,2,((40./100.)*batper)/1,20, SSD1306_WHITE);
    display.drawLine(0,25,128,25, SSD1306_WHITE);
    display.setCursor(0,30);
    display.print(F("Step: "));
    display.println(step);
    if (autonom == 2) {
      if (go == 1) {
        display.print(F("Dist: "));
        display.println(ptrinn*0.25);
      }
      if (go == 2) {
        display.print(F("Dist: "));
        display.println(ktrinn*0.25);
      }
    }
    else {
      display.print(F("Dist: "));
      display.println(ktrinn);
    }
    display.display();
  }
  //led-lys
  digitalWrite(l2, 0);
  digitalWrite(l1, 0);
  digitalWrite(l0, 0);
  if (fail) {
    digitalWrite(l2, 1);
  }
  if (autonom == 1) {
    digitalWrite(l1, 1);
  }
  if (!go) {
    digitalWrite(l0, 1);
  }
}
